## sdkconfig.defaults
```kconfig
#
# Serial flasher config
CONFIG_ESPTOOLPY_FLASHMODE_QIO=y
# end of Serial flasher config


#
# Compiler options
#
# CONFIG_COMPILER_OPTIMIZATION_DEFAULT is not set
CONFIG_COMPILER_OPTIMIZATION_SIZE=y

#
# ESP32S3-Specific
CONFIG_ESP32S3_DEFAULT_CPU_FREQ_240=y
CONFIG_ESP32S3_DEFAULT_CPU_FREQ_MHZ=240

#
# FreeRTOS
#
# CONFIG_FREERTOS_UNICORE is not set
CONFIG_FREERTOS_TICK_SUPPORT_SYSTIMER=y
CONFIG_FREERTOS_CORETIMER_SYSTIMER_LVL1=y
CONFIG_FREERTOS_SYSTICK_USES_SYSTIMER=y
CONFIG_FREERTOS_HZ=1000

# end of FreeRTOS

#
# Log output
#
CONFIG_LOG_DEFAULT_LEVEL_NONE=y
# end of Log output

CONFIG_ESP_COREDUMP_ENABLE_TO_FLASH=y

CONFIG_COMPILER_OPTIMIZATION_PERF=y

#
# Cache config
#
CONFIG_ESP32S3_INSTRUCTION_CACHE_32KB=y
CONFIG_ESP32S3_DATA_CACHE_64KB=y
CONFIG_ESP32S3_DATA_CACHE_LINE_64B=y


CONFIG_UART_ISR_IN_IRAM=y
CONFIG_ESP_WIFI_SLP_IRAM_OPT=y
CONFIG_LWIP_IRAM_OPTIMIZATION=y

#
# GDMA Configuration
#
CONFIG_GDMA_CTRL_FUNC_IN_IRAM=y
CONFIG_GDMA_ISR_IRAM_SAFE=y
# end of GDMA Configuration
```
